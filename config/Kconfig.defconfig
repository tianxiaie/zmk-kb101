## config/Kconfig.defconfig
```kconfig
# Copyright (c) 2020 The ZMK Contributors
# SPDX-License-Identifier: MIT


if SHIELD_SINCB_LEFT

config ZMK_KEYBOARD_NAME
    default "Sincb"

config ZMK_SPLIT_ROLE_CENTRAL
    default y

endif

if SHIELD_SINCB_LEFT || SHIELD_SINCB_RIGHT

config ZMK_SPLIT
    default y

endif
```

## config/Kconfig.shield
```kconfig
# Copyright (c) 2020 The ZMK Contributors
# SPDX-License-Identifier: MIT

config SHIELD_ SINCB_LEFT
    def_bool $(shields_list_contains, sincb_left)

config SHIELD_ SINCB_RIGHT
    def_bool $(shields_list_contains, sincb_right)
```
